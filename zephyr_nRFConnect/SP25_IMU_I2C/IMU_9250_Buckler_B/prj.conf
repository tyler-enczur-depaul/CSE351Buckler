## prj.conf
```kconfig
CONFIG_SERIAL=y
CONFIG_UART_ASYNC_API=y
CONFIG_I2C=y

# defining the following line allows to print floating point numbers
CONFIG_FPU=y
```

## src/main.c
```c
/*
 * Zephyr application for reading ambient light from OPT3004 sensor via I2C
 */
#include <zephyr/kernel.h>
#include <zephyr/device.h>
#include <zephyr/devicetree.h>
#include <zephyr/drivers/i2c.h>
#include <zephyr/sys/printk.h>

/* Locate and place these header files in the src folder*/
#include "mpu9250.h"

lsm9ds1_measurement_t lsm9ds1_read_accelerometer() {
  lsm9ds1_measurement_t meas = {0};
  uint8_t temp[6];

  // TODO: Use i2c_burst_read_dt or individual byte reads to get OUT_X_L_XL to OUT_Z_H_XL
  // IMPORTANT: When passing the register for reading operation
  // TODO: Combine bytes into int16_t ax, ay, az
  // TODO: Multiply each axis by aRes and store in meas

  return meas;
}

lsm9ds1_measurement_t lsm9ds1_read_gyro() {
  lsm9ds1_measurement_t meas = {0};
  uint8_t temp[6];

  // TODO: Use i2c_burst_read_dt or individual byte reads to get OUT_X_L_G to OUT_Z_H_G
  // TODO: Combine bytes into int16_t gx, gy, gz
  // TODO: Multiply each axis by gRes and store in meas

  return meas;
}

int main(void) {
  

	// 1. Configuration of I2C sensor for Accelerometer, Gyroscope,
	// 

	if (mpu9250_init()!=0){
		printk("Failed to configure the Sensor \n");
		return -1;
	}

	printk("Successfully configured the Sensor\n ");


	// lsm9ds1_measurement_t result;
	mpu9250_measurement_t result;
	while(1){
		// 2. Reading Operation from the sensor
		// result = lsm9ds1_read_accelerometer();
		result = mpu9250_read_accelerometer();
		// printk("Reading from the sensor \n");
		// 3. Displaying the result
		printk("X Axis: %2.2f, Y Axis: %2.2f, Z Axis: %2.2f \n",
       (double)result.x_axis, (double)result.y_axis, (double)result.z_axis);

		k_msleep(100);
	}
	
}
```

## src/mpu9250.c
```c
// // MPU-9250 driver
// //
// // Read from MPU-9250 3-axis accelerometer/gyro/magnetometer over I2C
// // Register documentation: http://www.invensense.com/wp-content/uploads/2017/11/RM-MPU-9250A-00-v1.6.pdf
// //
// // Based on https://github.com/sparkfun/SparkFun_MPU-9250-DMP_Arduino_Library/blob/master/src/util/inv_mpu.c

#include <stdbool.h>
#include <stdint.h>
#include<zephyr/device.h>
#include <zephyr/devicetree.h>
#include <zephyr/drivers/i2c.h>
#include <zephyr/kernel.h>
// #include "app_error.h"
// #include "nrf.h"
// #include "nrf_delay.h"
// #include "nrf_drv_timer.h"
// #include "nrf_twi_mngr.h"

#include "mpu9250.h"

#define SLEEP_TIME_MS 1
#define SENSOR_NODE DT_NODELABEL(mpu9250_accel)

const struct i2c_dt_spec dev_i2c = I2C_DT_SPEC_GET(SENSOR_NODE);


// static uint8_t MPU_ADDRESS = 0x68;
// static uint8_t MAG_ADDRESS = 0x0C;

// static const nrf_twi_mngr_t* i2c_manager = NULL;

// // rotation tracking variables
// static const nrf_drv_timer_t gyro_timer = NRFX_TIMER_INSTANCE(1);
// static mpu9250_measurement_t integrated_angle;
// static uint32_t prev_timer_val;

// static void gyro_timer_event_handler(nrf_timer_event_t event_type, void* p_context) {
//   // don't care about events
// }

// static uint8_t i2c_reg_read(uint8_t i2c_addr, uint8_t reg_addr) {
//   uint8_t rx_buf = 0;
//   nrf_twi_mngr_transfer_t const read_transfer[] = {
//     NRF_TWI_MNGR_WRITE(i2c_addr, &reg_addr, 1, NRF_TWI_MNGR_NO_STOP),
//     NRF_TWI_MNGR_READ(i2c_addr, &rx_buf, 1, 0),
//   };
//   ret_code_t error_code = nrf_twi_mngr_perform(i2c_manager, NULL, read_transfer, 2, NULL);
//   APP_ERROR_CHECK(error_code);
//   return rx_buf;
// }

// static void i2c_reg_write(uint8_t i2c_addr, uint8_t reg_addr, uint8_t data) {
//   uint8_t buf[2] = {reg_addr, data};
//   nrf_twi_mngr_transfer_t const write_transfer[] = {
//     NRF_TWI_MNGR_WRITE(i2c_addr, buf, 2, 0),
//   };
//   ret_code_t error_code = nrf_twi_mngr_perform(i2c_manager, NULL, write_transfer, 1, NULL);
//   APP_ERROR_CHECK(error_code);
// }

//   i2c_manager = i2c;

//   // initialize a timer - the default frequency is 16MHz
//   nrf_drv_timer_config_t timer_cfg = {
//     .frequency          = NRF_TIMER_FREQ_1MHz,
//     .mode               = NRF_TIMER_MODE_TIMER,
//     .bit_width          = NRF_TIMER_BIT_WIDTH_32,
//     .interrupt_priority = NRFX_TIMER_DEFAULT_CONFIG_IRQ_PRIORITY,
//     .p_context          = NULL,
//   };
//   //ret_code_t error_code = nrf_drv_timer_init(&gyro_timer, &timer_cfg, gyro_timer_event_handler);
//   ret_code_t error_code = nrfx_timer_init(&gyro_timer, &timer_cfg, gyro_timer_event_handler);
//   APP_ERROR_CHECK(error_code);

 

// initialization and configuration
// void mpu9250_init(cost nrf_twi_mngr_t* i2c) {
int mpu9250_init(){

if (!device_is_ready(dev_i2c.bus)) {
    printk("I2C device not ready\n");
    return -1;
}
printk("Ready to use the I2C device \n");
 // reset mpu
//   i2c_reg_write(MPU_ADDRESS, MPU9250_PWR_MGMT_1, 0x80);
// int ret;
uint8_t config_bytes[2];
int ret;

// Reset device
config_bytes[0] = MPU9250_PWR_MGMT_1;
config_bytes[1] = 0x80;
ret = i2c_write_dt(&dev_i2c, config_bytes, sizeof(config_bytes));
if (ret < 0) {
    printk("Failed to reset MPU9250 (PWR_MGMT_1)\n");
    printk("Reset failed: error code = %d\n", ret);
    return ret;

}

k_msleep(100);

// Disable sleep mode
config_bytes[0] = MPU9250_PWR_MGMT_1;
config_bytes[1] = 0x00;
ret = i2c_write_dt(&dev_i2c, config_bytes, sizeof(config_bytes));
if (ret < 0) {
    printk("Failed to disable sleep mode (PWR_MGMT_1)\n");
    return ret;
}

// Enable bypass mode
config_bytes[0] = MPU9250_USER_CTRL;
config_bytes[1] = 0x00;
ret = i2c_write_dt(&dev_i2c, config_bytes, sizeof(config_bytes));
if (ret < 0) {
    printk("Failed to write USER_CTRL register\n");
    return ret;
}

k_msleep(3);

// Configure INT pin
config_bytes[0] = MPU9250_INT_PIN_CFG;
config_bytes[1] = 0x02;
ret = i2c_write_dt(&dev_i2c, config_bytes, sizeof(config_bytes));
if (ret < 0) {
    printk("Failed to write INT_PIN_CFG register\n");
    return ret;
}

// Configure gyro range
config_bytes[0] = MPU9250_GYRO_CONFIG;
config_bytes[1] = 0x18;
ret = i2c_write_dt(&dev_i2c, config_bytes, sizeof(config_bytes));
if (ret < 0) {
    printk("Failed to configure GYRO_CONFIG register\n");
    return ret;
}

// Configure accelerometer range
config_bytes[0] = MPU9250_ACCEL_CONFIG;
config_bytes[1] = 0x00;
ret = i2c_write_dt(&dev_i2c, config_bytes, sizeof(config_bytes));
if (ret < 0) {
    printk("Failed to configure ACCEL_CONFIG register\n");
    return ret;
}

// Reset magnetometer
config_bytes[0] = AK8963_CNTL2;
config_bytes[1] = 0x01;
ret = i2c_write_dt(&dev_i2c, config_bytes, sizeof(config_bytes));
if (ret < 0) {
    printk("Failed to reset AK8963 (CNTL2)\n");
    return ret;
}

k_msleep(100);

// Configure magnetometer for continuous measurement mode
config_bytes[0] = AK8963_CNTL1;
config_bytes[1] = 0x02;
ret = i2c_write_dt(&dev_i2c, config_bytes, sizeof(config_bytes));
if (ret < 0) {
    printk("Failed to set AK8963 to continuous measurement mode (CNTL1)\n");
    return ret;
}

return 0;
}

mpu9250_measurement_t mpu9250_read_accelerometer() {
  // read values
  

//   int16_t x_val = (((uint16_t)i2c_reg_read(MPU_ADDRESS, MPU9250_ACCEL_XOUT_H)) << 8) | i2c_reg_read(MPU_ADDRESS, MPU9250_ACCEL_XOUT_L);
//   int16_t y_val = (((uint16_t)i2c_reg_read(MPU_ADDRESS, MPU9250_ACCEL_YOUT_H)) << 8) | i2c_reg_read(MPU_ADDRESS, MPU9250_ACCEL_YOUT_L);
//   int16_t z_val = (((uint16_t)i2c_reg_read(MPU_ADDRESS, MPU9250_ACCEL_ZOUT_H)) << 8) | i2c_reg_read(MPU_ADDRESS, MPU9250_ACCEL_ZOUT_L);



int8_t x_val[2] = {0};  // [0] = low byte, [1] = high byte
int8_t y_val[2] = {0};
int8_t z_val[2] = {0};
int ret_code = 0;

// X-axis
ret_code = i2c_reg_read_byte_dt(&dev_i2c, MPU9250_ACCEL_XOUT_L, &x_val[0]);
if (ret_code < 0) {
    printk("Failed to read ACCEL_XOUT_L: %d\n", ret_code);
}

ret_code = i2c_reg_read_byte_dt(&dev_i2c, MPU9250_ACCEL_XOUT_H, &x_val[1]);
if (ret_code < 0) {
    printk("Failed to read ACCEL_XOUT_H: %d\n", ret_code);
}

// Y-axis
ret_code = i2c_reg_read_byte_dt(&dev_i2c, MPU9250_ACCEL_YOUT_L, &y_val[0]);
if (ret_code < 0) {
    printk("Failed to read ACCEL_YOUT_L: %d\n", ret_code);
}

ret_code = i2c_reg_read_byte_dt(&dev_i2c, MPU9250_ACCEL_YOUT_H, &y_val[1]);
if (ret_code < 0) {
    printk("Failed to read ACCEL_YOUT_H: %d\n", ret_code);
}

// Z-axis
ret_code = i2c_reg_read_byte_dt(&dev_i2c, MPU9250_ACCEL_ZOUT_L, &z_val[0]);
if (ret_code < 0) {
    printk("Failed to read ACCEL_ZOUT_L: %d\n", ret_code);
}

ret_code = i2c_reg_read_byte_dt(&dev_i2c,MPU9250_ACCEL_ZOUT_H, &z_val[1]);
if (ret_code < 0) {
    printk("Failed to read ACCEL_ZOUT_H: %d\n", ret_code);
}



//   int16_t x_val, y_val, z_val;

//   x_val = ((uint16_t)(x_val_h<<8) | x_val_l);
//   y_val = (y_val_h)<<8 | y_val_l;
//   z_val = (z_val_h)<<8 | z_val_l;
int16_t x = (int16_t)(((uint8_t)x_val[1] << 8) | (uint8_t)x_val[0]);
int16_t y = (int16_t)(((uint8_t)y_val[1] << 8) | (uint8_t)y_val[0]);
int16_t z = (int16_t)(((uint8_t)z_val[1] << 8) | (uint8_t)z_val[0]);
  // convert to g
  // coversion at +/- 2 g is 16384 LSB/g
  mpu9250_measurement_t measurement = {0};
  measurement.x_axis = ((float)x) / 16384;
  measurement.y_axis = ((float)y) / 16384;
  measurement.z_axis = ((float)z) / 16384;
  
//   printk("x_axis: %f, y_axis: %f, z_axis: %f\n", measurement.x_axis, measurement.y_axis, measurement.z_axis);
  return measurement;
}

// mpu9250_measurement_t mpu9250_read_gyro() {
//   // read values
//   int16_t x_val = (((uint16_t)i2c_reg_read(MPU_ADDRESS, MPU9250_GYRO_XOUT_H)) << 8) | i2c_reg_read(MPU_ADDRESS, MPU9250_GYRO_XOUT_L);
//   int16_t y_val = (((uint16_t)i2c_reg_read(MPU_ADDRESS, MPU9250_GYRO_YOUT_H)) << 8) | i2c_reg_read(MPU_ADDRESS, MPU9250_GYRO_YOUT_L);
//   int16_t z_val = (((uint16_t)i2c_reg_read(MPU_ADDRESS, MPU9250_GYRO_ZOUT_H)) << 8) | i2c_reg_read(MPU_ADDRESS, MPU9250_GYRO_ZOUT_L);

//   // convert to g
//   // coversion at +/- 2000 degrees/second is 16.4 LSB/g
//   mpu9250_measurement_t measurement = {0};
//   measurement.x_axis = ((float)x_val) / 16.4;
//   measurement.y_axis = ((float)y_val) / 16.4;
//   measurement.z_axis = ((float)z_val) / 16.4;
//   return measurement;
// }

// mpu9250_measurement_t mpu9250_read_magnetometer() {

//   // read data
//   // must read 8 bytes starting at the first status register
//   uint8_t reg_addr = AK8963_ST1;
//   uint8_t rx_buf[8] = {0};
//   nrf_twi_mngr_transfer_t const read_transfer[] = {
//     NRF_TWI_MNGR_WRITE(MAG_ADDRESS, &reg_addr, 1, NRF_TWI_MNGR_NO_STOP),
//     NRF_TWI_MNGR_READ(MAG_ADDRESS, rx_buf, 8, 0),
//   };
//   ret_code_t error_code = nrf_twi_mngr_perform(i2c_manager, NULL, read_transfer, 2, NULL);
//   APP_ERROR_CHECK(error_code);

//   // determine values
//   int16_t x_val = (((uint16_t)rx_buf[2]) << 8) | rx_buf[1];
//   int16_t y_val = (((uint16_t)rx_buf[4]) << 8) | rx_buf[3];
//   int16_t z_val = (((uint16_t)rx_buf[6]) << 8) | rx_buf[5];

//   // convert to g
//   // coversion is 0.6 uT/LSB
//   mpu9250_measurement_t measurement = {0};
//   measurement.x_axis = ((float)x_val) * 0.6;
//   measurement.y_axis = ((float)y_val) * 0.6;
//   measurement.z_axis = ((float)z_val) * 0.6;

//   return measurement;
// }

// ret_code_t mpu9250_start_gyro_integration() {
//   if (nrfx_timer_is_enabled(&gyro_timer)) {
//     return NRF_ERROR_INVALID_STATE;
//   }

//   // zero the angle
//   integrated_angle.z_axis = 0;
//   integrated_angle.y_axis = 0;
//   integrated_angle.x_axis = 0;

//   nrfx_timer_clear(&gyro_timer);
//   nrfx_timer_enable(&gyro_timer);
//   prev_timer_val = 0;

//   return NRF_SUCCESS;
// }

// void mpu9250_stop_gyro_integration() {
//   nrfx_timer_disable(&gyro_timer);
// }

// mpu9250_measurement_t mpu9250_read_gyro_integration() {
//   uint32_t curr_timer_val = nrfx_timer_capture(&gyro_timer, NRF_TIMER_CC_CHANNEL0);
//   float time_diff = ((float)(curr_timer_val - prev_timer_val))/1000000.0;
//   //printf("curr %lu prev %lu diff %f\n", curr_timer_val, prev_timer_val, time_diff);
//   prev_timer_val = curr_timer_val;
//   mpu9250_measurement_t measure = mpu9250_read_gyro();
//   if (measure.z_axis > 0.5 || measure.z_axis < -0.5) {
//     integrated_angle.z_axis += measure.z_axis*time_diff;
//   }
//   if (measure.x_axis > 0.5 || measure.x_axis < -0.5) {
//     integrated_angle.x_axis += measure.x_axis*time_diff;
//   }
//   if (measure.y_axis > 0.5 || measure.y_axis < -0.5) {
//     integrated_angle.y_axis += measure.y_axis*time_diff;
//   }
//   return integrated_angle;
// }
```

## src/mpu9250.h
```c
// MPU-9250 driver
//
// Read from MPU-9250 3-axis accelerometer/gyro/magnetometer over I2C

#pragma once

// #include "app_error.h"
// #include "nrf_twi_mngr.h"

// Types

typedef struct {
	float x_axis;
	float y_axis;
	float z_axis;
} mpu9250_measurement_t;


// Function prototypes

// Initialize and configure the MPU-9250
//
// i2c - pointer to already initialized and enabled twim instance
// void mpu9250_init(const nrf_twi_mngr_t* i2c);
int mpu9250_init();

// Read all three axes on the accelerometer
//
// Return measurements as floating point values in g's
mpu9250_measurement_t mpu9250_read_accelerometer();

// Read all three axes on the gyro
//
// Return measurements as floating point values in degrees/second
mpu9250_measurement_t mpu9250_read_gyro();

// Read all three axes on the magnetometer
//
// Return measurements as floating point values in uT
mpu9250_measurement_t mpu9250_read_magnetometer();

// Start integration on the gyro
//
// Return an NRF error code
//  - must be stopped before starting
int mpu9250_start_gyro_integration();

// Stop integration on the gyro
void mpu9250_stop_gyro_integration();

// Read the value of the integrated gyro
//
// Note: this function also performs the integration and needs to be called
// periodically
//
// Return the integrated value as floating point in degrees
mpu9250_measurement_t mpu9250_read_gyro_integration();

// Definitions

typedef enum {
	MPU9250_SELF_TEST_X_GYRO =  0x00,
	MPU9250_SELF_TEST_Y_GYRO =  0x01,
	MPU9250_SELF_TEST_Z_GYRO =  0x02,
	MPU9250_SELF_TEST_X_ACCEL = 0x0D,
	MPU9250_SELF_TEST_Y_ACCEL = 0x0E,
	MPU9250_SELF_TEST_Z_ACCEL = 0x0F,
	MPU9250_XG_OFFSET_H =       0x13,
	MPU9250_XG_OFFSET_L =       0x14,
	MPU9250_YG_OFFSET_H =       0x15,
	MPU9250_YG_OFFSET_L =       0x16,
	MPU9250_ZG_OFFSET_H =       0x17,
	MPU9250_ZG_OFFSET_L =       0x18,
	MPU9250_SMPLRT_DIV =        0x19,
	MPU9250_CONFIG =            0x1A,
	MPU9250_GYRO_CONFIG =       0x1B,
	MPU9250_ACCEL_CONFIG =      0x1C,
	MPU9250_ACCEL_CONFIG_2 =    0x1D,
	MPU9250_LP_ACCEL_ODR =      0x1E,
	MPU9250_WOM_THR =           0x1F,
	MPU9250_FIFO_EN =           0x23,
	MPU9250_I2C_MST_CTRL =      0x24,
	MPU9250_I2C_SLV0_ADDR =     0x25,
	MPU9250_I2C_SLV0_REG =      0x26,
	MPU9250_I2C_SLV0_CTRL =     0x27,
	MPU9250_I2C_SLV1_ADDR =     0x28,
	MPU9250_I2C_SLV1_REG =      0x29,
	MPU9250_I2C_SLV1_CTRL =     0x2A,
	MPU9250_I2C_SLV2_ADDR =     0x2B,
	MPU9250_I2C_SLV2_REG =      0x2C,
	MPU9250_I2C_SLV2_CTRL =     0x2D,
	MPU9250_I2C_SLV3_ADDR =     0x2E,
	MPU9250_I2C_SLV3_REG =      0x2F,
	MPU9250_I2C_SLV3_CTRL =     0x30,
	MPU9250_I2C_SLV4_ADDR =     0x31,
	MPU9250_I2C_SLV4_REG =      0x32,
	MPU9250_I2C_SLV4_DO =       0x33,
	MPU9250_I2C_SLV4_CTRL =     0x34,
	MPU9250_I2C_SLV4_DI =       0x35,
	MPU9250_I2C_MST_STATUS =    0x36,
	MPU9250_INT_PIN_CFG =       0x37,
	MPU9250_INT_ENABLE =        0x38,
	MPU9250_INT_STATUS =        0x3A,
	MPU9250_ACCEL_XOUT_H =      0x3B,
	MPU9250_ACCEL_XOUT_L =      0x3C,
	MPU9250_ACCEL_YOUT_H =      0x3D,
	MPU9250_ACCEL_YOUT_L =      0x3E,
	MPU9250_ACCEL_ZOUT_H =      0x3F,
	MPU9250_ACCEL_ZOUT_L =      0x40,
	MPU9250_TEMP_OUT_H =        0x41,
	MPU9250_TEMP_OUT_L =        0x42,
	MPU9250_GYRO_XOUT_H =       0x43,
	MPU9250_GYRO_XOUT_L =       0x44,
	MPU9250_GYRO_YOUT_H =       0x45,
	MPU9250_GYRO_YOUT_L =       0x46,
	MPU9250_GYRO_ZOUT_H =       0x47,
	MPU9250_GYRO_ZOUT_L =       0x48,
	MPU9250_EXT_SENS_DATA_00 =  0x49,
	MPU9250_EXT_SENS_DATA_01 =  0x4A,
	MPU9250_EXT_SENS_DATA_02 =  0x4B,
	MPU9250_EXT_SENS_DATA_03 =  0x4C,
	MPU9250_EXT_SENS_DATA_04 =  0x4D,
	MPU9250_EXT_SENS_DATA_05 =  0x4E,
	MPU9250_EXT_SENS_DATA_06 =  0x4F,
	MPU9250_EXT_SENS_DATA_07 =  0x50,
	MPU9250_EXT_SENS_DATA_08 =  0x51,
	MPU9250_EXT_SENS_DATA_09 =  0x52,
	MPU9250_EXT_SENS_DATA_10 =  0x53,
	MPU9250_EXT_SENS_DATA_11 =  0x54,
	MPU9250_EXT_SENS_DATA_12 =  0x55,
	MPU9250_EXT_SENS_DATA_13 =  0x56,
	MPU9250_EXT_SENS_DATA_14 =  0x57,
	MPU9250_EXT_SENS_DATA_15 =  0x58,
	MPU9250_EXT_SENS_DATA_16 =  0x59,
	MPU9250_EXT_SENS_DATA_17 =  0x5A,
	MPU9250_EXT_SENS_DATA_18 =  0x5B,
	MPU9250_EXT_SENS_DATA_19 =  0x5C,
	MPU9250_EXT_SENS_DATA_20 =  0x5D,
	MPU9250_EXT_SENS_DATA_21 =  0x5E,
	MPU9250_EXT_SENS_DATA_22 =  0x5F,
	MPU9250_EXT_SENS_DATA_23 =  0x60,
	MPU9250_I2C_SLV0_DO =       0x63,
	MPU9250_I2C_SLV1_DO =       0x64,
	MPU9250_I2C_SLV2_DO =       0x65,
	MPU9250_I2C_SLV3_DO =       0x66,
	MPU9250_I2C_MST_DELAY_CTRL =0x67,
	MPU9250_SIGNAL_PATH_RESET = 0x68,
	MPU9250_MOT_DETECT_CTRL =   0x69,
	MPU9250_USER_CTRL =         0x6A,
	MPU9250_PWR_MGMT_1 =        0x6B,
	MPU9250_PWR_MGMT_2 =        0x6C,
	MPU9250_FIFO_COUNTH =       0x72,
	MPU9250_FIFO_COUNTL =       0x73,
	MPU9250_FIFO_R_W =          0x74,
	MPU9250_WHO_AM_I =          0x75,
	MPU9250_XA_OFFSET_H =       0x77,
	MPU9250_XA_OFFSET_L =       0x78,
	MPU9250_YA_OFFSET_H =       0x7A,
	MPU9250_YA_OFFSET_L =       0x7B,
	MPU9250_ZA_OFFSET_H =       0x7D,
	MPU9250_ZA_OFFSET_L =       0x7E
} mpu9250_reg_t;

typedef enum {
	AK8963_WIA = 0x0,
	AK8963_INFO = 0x1,
	AK8963_ST1 = 0x2,
	AK8963_HXL = 0x3,
	AK8963_HXH = 0x4,
	AK8963_HYL = 0x5,
	AK8963_HYH = 0x6,
	AK8963_HZL = 0x7,
	AK8963_HZH = 0x8,
	AK8963_ST2 = 0x9,
	AK8963_CNTL1 = 0xA,
	AK8963_CNTL2 = 0xB,
	AK8963_ASTC = 0xC,
	AK8963_TS1 = 0xD,
	AK8963_TS2 = 0xE,
	AK8963_I2CDIS = 0xF,
	AK8963_ASAX = 0x10,
	AK8963_ASAY = 0x11,
	AK8963_ASAZ = 0x12,
} ak8963_reg_t;
```
